#include <KeyDuino.h>

//A-Keys Array
uint8_t definedKeysA[16][6] = {
  { 0x48, 0x45, 0x58, 0x41, 0x43, 0x54 },
  { 0x48, 0x45, 0x58, 0x41, 0x43, 0x54 },
  { 0x48, 0x45, 0x58, 0x41, 0x43, 0x54 },
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  { 0x48, 0x45, 0x58, 0x41, 0x43, 0x54 }
};

//B-Keys Array
uint8_t definedKeysB[16][6] = {
  { 0xA2, 0x2A, 0xE1, 0x29, 0xC0, 0x13 },
  { 0x49, 0xFA, 0xE4, 0xE3, 0x84, 0x9F },
  { 0x38, 0xFC, 0xF3, 0x30, 0x72, 0xE0 },
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  { 0x48, 0x45, 0x58, 0x41, 0x43, 0x54 }
};

MifareClassicKeyDuino keyDuino;

uint8_t uid[] = { 0, 0, 0, 0, 0, 0, 0 }; 
uint8_t uidLength;

uint8_t authenticateDefinedKey(uint8_t key[6], int keyType, int sector);


void setup(void) {
  Serial.begin(115200);
  
  keyDuino.begin();

  keyDuino.SAMConfig();
}

void loop(void) {
  uint8_t success;

  success = keyDuino.mifareclassic_ReadTargetID(uid, &uidLength);

  if (success) {
    if (uidLength == 4) {
      Serial.print("Mifare Classic identified: UID: ");
      keyDuino.PrintHex(uid, uidLength);
      
      for (int i = 0 ; i < 16 ; i++) { // 16 if card is Mifare 1K, 64 if Mifare 4K
        if (authenticateDefinedKey(definedKeysA[i], MIFARE_KEY_A, i) || authenticateDefinedKey(definedKeysB[i], MIFARE_KEY_B, i) || keyDuino.mifareclassic_AuthenticateSectorDefaultKeys(i)) //Try authentication with defined key A, then B, then default keys
            keyDuino.mifareclassic_ReadSector(i);       
      }
    }
    delay(6000);
  }
}


uint8_t authenticateDefinedKey(uint8_t key[6], int keyType, int sector){
    
    uint8_t auth = keyDuino.mifareclassic_AuthenticateBlock(uid, uidLength, sector * 4, keyType, key);
    
    if(auth) {
        Serial.print("Authentication succeeded on sector ");
        Serial.print(sector);
        Serial.print(" with key ");
        if(!keyType)
            Serial.print("A :");
        else
            Serial.print("B :");
        keyDuino.PrintHex(key, 6);
        return true;
    }
    else {
        Serial.print("Failed authentication on sector ");
        Serial.print(sector);
        Serial.print(" with key ");
        if(!keyType)
            Serial.print("A :");
        else
          Serial.print("B :");
        keyDuino.PrintHex(key, 6);
        Serial.println();
        return false;
  }
}
