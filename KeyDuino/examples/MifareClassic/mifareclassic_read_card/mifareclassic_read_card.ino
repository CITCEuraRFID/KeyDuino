/*
This sketch is made to be used with a Mifare Classic card, and serves as an example to read its sectors.
It uses the MifareClassicKeyDuino class, which is an extension of KeyDuino class, easing the learning with Mifare Classic.

Author: Raymond Borenstein - CITC-EuraRFID

Compatible with KeyDuino 5.1

Join http://keyduino.forumsactifs.com/ to ask your questions, suggest your ideas, and show your projects!
*/

#include <KeyDuino.h>

//Define here the keys of each sector of your Mifare Classic card, if you know them. 
//Otherwise, only typical default keys will be used.

//Defined A-Keys Array
uint8_t definedKeysA[16][6] = {
  { 0x48, 0x45, 0x58, 0x41, 0x43, 0x54 },
  { 0x48, 0x45, 0x58, 0x41, 0x43, 0x54 },
  { 0x48, 0x45, 0x58, 0x41, 0x43, 0x54 },
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  { 0x48, 0x45, 0x58, 0x41, 0x43, 0x54 }
};

// Defined B-Keys Array
uint8_t definedKeysB[16][6] = {
  { 0xA2, 0x2A, 0xE1, 0x29, 0xC0, 0x13 },
  { 0x49, 0xFA, 0xE4, 0xE3, 0x84, 0x9F },
  { 0x38, 0xFC, 0xF3, 0x30, 0x72, 0xE0 },
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  { 0x48, 0x45, 0x58, 0x41, 0x43, 0x54 }
};

MifareClassicKeyDuino keyDuino;

uint8_t uid[] = { 0, 0, 0, 0, 0, 0, 0 }; 
uint8_t uidLength;

void setup(void) {
  Serial.begin(115200);
  
  keyDuino.begin();

  keyDuino.SAMConfig();

  Serial.println("Waiting for a Mifare Classic tag to read.");
}

void loop(void) {
  uint8_t success;

  //Try to read card UID
  success = keyDuino.readTargetID(PN532_MIFARE_ISO14443A, uid, &uidLength);

  if (success) {
    if (uidLength == 4) {
      Serial.print("Mifare Classic identified: UID: ");
      keyDuino.PrintHex(uid, uidLength);
      
      for (int i = 0 ; i < 16 ; i++) { // 16 if card is Mifare 1K, 64 if Mifare 4K
        //Try authentication with defined key A, then B, then default keys.
        if (keyDuino.authenticateDefinedKey(definedKeysA[i], MIFARE_KEY_A, i) || 
	      keyDuino.authenticateDefinedKey(definedKeysB[i], MIFARE_KEY_B, i) || 
	      keyDuino.mifareclassic_AuthenticateSectorDefaultKeys(i))
            keyDuino.readSector(i);       
      }
      delay(500);
      Serial.println("Operation complete.");
      Serial.println("Press a key for next operation.");
      while (!Serial.available());
      while (Serial.available()) Serial.read();
      Serial.println("Waiting for a Mifare Classic tag to read.");
    } else {
      Serial.println("Detected tag is not Mifare Classic.");
      delay(500);
    }
  }
}



